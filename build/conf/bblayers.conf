## build/conf/bblayers.conf
```bitbake
# This template file was created by taking the oe-core/meta/conf/bblayers.conf
# file and removing the BBLAYERS section at the end.

# LAYER_CONF_VERSION is increased each time build/conf/bblayers.conf
# changes incompatibly
LCONF_VERSION = "7"

BBPATH = "${TOPDIR}"
BBFILES ?= ""

# Layers configured by oe-core-setup script
BBLAYERS += " \
	${OEBASE}/sources/meta-processor-sdk \
	${OEBASE}/sources/meta-aws \
	${OEBASE}/sources/meta-ros \
	${OEBASE}/sources/meta-arago/meta-arago-distro \
	${OEBASE}/sources/meta-arago/meta-arago-extras \
	${OEBASE}/sources/meta-browser \
	${OEBASE}/sources/meta-qt5 \
	${OEBASE}/sources/meta-virtualization \
	${OEBASE}/sources/meta-openembedded/meta-networking \
	${OEBASE}/sources/meta-openembedded/meta-python \
	${OEBASE}/sources/meta-openembedded/meta-oe \
	${OEBASE}/sources/meta-openembedded/meta-gnome \
	${OEBASE}/sources/meta-openembedded/meta-multimedia \
	${OEBASE}/sources/meta-openembedded/meta-filesystems \
	${OEBASE}/sources/meta-ti \
	${OEBASE}/sources/meta-linaro/meta-linaro-toolchain \
	${OEBASE}/sources/meta-linaro/meta-optee \
	${OEBASE}/sources/oe-core/meta \
"
```
